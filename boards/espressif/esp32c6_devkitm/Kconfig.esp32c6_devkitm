## boards/espressif/esp32c6_devkitm/Kconfig.esp32c6_devkitm
```kconfig
# Copyright (c) 2026 Espressif Systems (Shanghai) Co., Ltd.
# SPDX-License-Identifier: Apache-2.0

config BOARD_ESP32C6_DEVKITM
	select SOC_ESP32_C6_MINI_1U_N4
	select SOC_ESP32C6_HPCORE if BOARD_ESP32C6_DEVKITM_ESP32C6_HPCORE
	select SOC_ESP32C6_LPCORE if BOARD_ESP32C6_DEVKITM_ESP32C6_LPCORE
```

## boards/espressif/esp32c6_devkitm/board.yml
```yaml
board:
  name: esp32c6_devkitm
  full_name: ESP32-C6-DevKitM
  vendor: espressif
  socs:
  - name: esp32c6
```

## dts/bindings/gnss/u-blox,m10.yaml
```yaml
# Copyright (c) 2026 Hong Nguyen <hong.nguyen.k54@gmail.com>
# SPDX-License-Identifier: Apache-2.0

description: U-BLOX M10 GNSS Module

compatible: "u-blox,m10"

include:
  - uart-device.yaml
  - u-blox,common.yaml
```
